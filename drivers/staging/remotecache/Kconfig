## drivers/staging/remotecache/Kconfig
```kconfig
config REMOTECACHE
	bool "Remotecache"
	default n
	depends on CLEANCACHE
	help
	  Enable support for remotecache API

config REMOTECACHE_MODULE
	tristate "Remotecache module"
	default m
	depends on REMOTECACHE && LIBCRC32C && m
	help
	  Enable support for remotecache

config REMOTECACHE_DEBUG
	bool "Enable remotecache debug messages"
	default n
	depends on REMOTECACHE
	help
	  Enable additionnal debugging messages for remotecache.
```
